VERSION "sample"

NS_ :

BS_:

BU_: ECU1 ECU2

BO_ 256 ExampleMessage: 8 ECU1
 SG_ Speed : 0|16@1+ (0.01,0) [0|250] "km/h" ECU2
 SG_ Rpm : 16|16@1+ (1,0) [0|8000] "rpm" ECU2

CM_ BO_ 256 "Example message for demo";
